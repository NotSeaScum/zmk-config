## config/boards/shields/reviung34/Kconfig.defconfig
```kconfig
if SHIELD_REVIUNG34_DONGLE

config ZMK_KEYBOARD_NAME
    default "REVIUNG34"

config ZMK_SPLIT_ROLE_CENTRAL
    default y

endif

if SHIELD_REVIUNG34_MAIN || SHIELD_REVIUNG34_DONGLE

config ZMK_SPLIT
    default y

endif
```

## config/boards/shields/reviung34/Kconfig.shield
```kconfig
config SHIELD_reviung34_MAIN
    def_bool $(shields_list_contains,reviung34_main)

config SHIELD_reviung34_DONGLE
	def_bool $(shields_list_contains,reviung34_dongle)
```
